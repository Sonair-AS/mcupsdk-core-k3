/**
 * @cliArgs --device "AM275x" --package "ANJ" --part "AM2754" --context "r5fss0-0" --product "MCU_PLUS_SDK@07.03.01"
 * @versions {"tool":"1.20.0+3587"}
 */

/**
 * Import the modules used in this configuration.
 */
const epwm       = scripting.addModule("/drivers/epwm/epwm", {}, false);
const epwm1      = epwm.addInstance();
const epwm2      = epwm.addInstance();
const epwm3      = epwm.addInstance();
const gpio       = scripting.addModule("/drivers/gpio/gpio", {}, false);
const gpio1      = gpio.addInstance();
const clock      = scripting.addModule("/kernel/dpl/clock");
const debug_log  = scripting.addModule("/kernel/dpl/debug_log");
const mpu_armv7  = scripting.addModule("/kernel/dpl/mpu_armv7", {}, false);
const mpu_armv71 = mpu_armv7.addInstance();
const mpu_armv72 = mpu_armv7.addInstance();
const mpu_armv73 = mpu_armv7.addInstance();
const mpu_armv74 = mpu_armv7.addInstance();
const mpu_armv75 = mpu_armv7.addInstance();
const mpu_armv76 = mpu_armv7.addInstance();

/**
 * Write custom configuration values to the imported modules.
 */
epwm1.$name            = "CONFIG_EPWM0";
epwm1.EPWM.A.$assign   = "SPI0_CS0";
epwm1.EPWM.B.$assign   = "SPI0_CS1";
epwm1.EPWM.SYNCO.$used = false;
epwm1.EPWM.SYNCI.$used = false;

epwm2.$name            = "CONFIG_EPWM1";
epwm2.EPWM.SYNCO.$used = false;
epwm2.EPWM.SYNCI.$used = false;

epwm3.$name            = "CONFIG_EPWM2";
epwm3.EPWM.SYNCO.$used = false;
epwm3.EPWM.SYNCI.$used = false;

gpio1.$name  = "CONFIG_GPIO0";
gpio1.pinDir = "OUTPUT";

debug_log.enableUartLog = true;
debug_log.uartTrace     = true;
debug_log.uartLog.$name = "CONFIG_UART0";

mpu_armv71.accessPermissions = "Supervisor RD+WR, User RD";
mpu_armv71.allowExecute      = false;
mpu_armv71.size              = 31;
mpu_armv71.attributes        = "Device";
mpu_armv71.$name             = "REGISTER_REGION";

mpu_armv72.accessPermissions = "Supervisor RD+WR, User RD";
mpu_armv72.size              = 7;
mpu_armv72.$name             = "TCMA_VEC";

mpu_armv73.$name    = "DDR";
mpu_armv73.baseAddr = 0x90000000;
mpu_armv73.size     = 28;

mpu_armv74.baseAddr   = 0x41010000;
mpu_armv74.size       = 15;
mpu_armv74.attributes = "NonCached";
mpu_armv74.$name      = "TCMB";

mpu_armv75.size       = 15;
mpu_armv75.attributes = "NonCached";
mpu_armv75.$name      = "TCMA";

mpu_armv76.baseAddr = 0x43C00000;
mpu_armv76.size     = 18;
mpu_armv76.$name    = "HSM_RAM";

/**
 * Pinmux solution for unlocked pins/peripherals. This ensures that minor changes to the automatic solver in a future
 * version of the tool will not impact the pinmux you originally saw.  These lines can be completely deleted in order to
 * re-solve from scratch.
 */
epwm1.EPWM.$suggestSolution                 = "EPWM0";
epwm2.EPWM.$suggestSolution                 = "EPWM2";
epwm2.EPWM.A.$suggestSolution               = "MMC0_CLK";
epwm2.EPWM.B.$suggestSolution               = "MMC0_CMD";
epwm3.EPWM.$suggestSolution                 = "EPWM1";
epwm3.EPWM.A.$suggestSolution               = "MMC0_DAT2";
epwm3.EPWM.B.$suggestSolution               = "AUDIO_EXT_REFCLK0";
gpio1.GPIO.$suggestSolution                 = "OSPI0_CLK";
debug_log.uartLog.UART.$suggestSolution     = "UART0";
debug_log.uartLog.UART.RXD.$suggestSolution = "MCASP4_AXR0";
debug_log.uartLog.UART.TXD.$suggestSolution = "MLB0_MLBCLK";
