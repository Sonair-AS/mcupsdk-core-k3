/**
 * @cliArgs --device "AM275x" --part "AM2754" --package "ANJ" --context "wkup-r5fss0-0" --product "MCU_PLUS_SDK@07.03.01"
 * @versions {"tool":"1.21.0+3721"}
 */

/**
 * Import the modules used in this configuration.
 */
const bootloader  = scripting.addModule("/drivers/bootloader/bootloader", {}, false);
const bootloader1 = bootloader.addInstance();
const debug_log   = scripting.addModule("/kernel/dpl/debug_log");
const mpu_armv7   = scripting.addModule("/kernel/dpl/mpu_armv7", {}, false);
const mpu_armv71  = mpu_armv7.addInstance();
const mpu_armv72  = mpu_armv7.addInstance();
const mpu_armv73  = mpu_armv7.addInstance();
const mpu_armv74  = mpu_armv7.addInstance();
const mpu_armv75  = mpu_armv7.addInstance();
const mpu_armv76  = mpu_armv7.addInstance();

/**
 * Write custom configuration values to the imported modules.
 */
bootloader1.$name     = "CONFIG_BOOTLOADER0";
bootloader1.bootMedia = "MEM";

debug_log.enableUartLog             = true;
debug_log.enableCssLog              = false;
debug_log.uartLog.$name             = "CONFIG_UART0";
debug_log.uartLog.hwFlowControl     = true;
debug_log.uartLog.intrEnable        = "DISABLE";
debug_log.uartLog.UART.$assign      = "UART0";
debug_log.uartLog.UART.RXD.$assign  = "UART0_RXD";
debug_log.uartLog.UART.TXD.$assign  = "UART0_TXD";
debug_log.uartLog.UART.RTSn.$assign = "UART0_RTSn";
debug_log.uartLog.UART.CTSn.$assign = "UART0_CTSn";

mpu_armv71.size         = 31;
mpu_armv71.attributes   = "Device";
mpu_armv71.allowExecute = false;
mpu_armv71.$name        = "CONFIG_MPU_REGISTER";

mpu_armv72.size       = 15;
mpu_armv72.$name      = "CONFIG_MPU_TCMA";
mpu_armv72.attributes = "NonCached";

mpu_armv73.baseAddr   = 0x41010000;
mpu_armv73.size       = 15;
mpu_armv73.$name      = "CONFIG_MPU_TCMB";
mpu_armv73.attributes = "NonCached";

mpu_armv74.$name    = "HSRAM";
mpu_armv74.baseAddr = 0x43C00000;
mpu_armv74.size     = 19;

mpu_armv75.$name    = "OCMC_RAM";
mpu_armv75.size     = 20;
mpu_armv75.baseAddr = 0x72000000;

mpu_armv76.$name        = "CONFIG_MPU_REGION0";
mpu_armv76.baseAddr     = 0x5C00000;
mpu_armv76.size         = 16;
mpu_armv76.attributes   = "NonCached";
mpu_armv76.allowExecute = false;
