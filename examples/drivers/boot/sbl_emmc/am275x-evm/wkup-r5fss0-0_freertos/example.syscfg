/**
 * @cliArgs --device "AM275x" --part "AM2754" --package "ANJ" --context "wkup-r5fss0-0" --product "MCU_PLUS_SDK@07.03.01"
 * @versions {"tool":"1.21.0+3721"}
 */

/**
 * Import the modules used in this configuration.
 */
const bootloader  = scripting.addModule("/drivers/bootloader/bootloader", {}, false);
const bootloader1 = bootloader.addInstance();
const bootloader2 = bootloader.addInstance();
const bootloader3 = bootloader.addInstance();
const bootloader4 = bootloader.addInstance();
const bootloader5 = bootloader.addInstance();
const bootloader6 = bootloader.addInstance();
const mmcsd       = scripting.addModule("/drivers/mmcsd/mmcsd", {}, false);
const mmcsd1      = mmcsd.addInstance();
const uart        = scripting.addModule("/drivers/uart/uart", {}, false);
const uart1       = uart.addInstance();
const debug_log   = scripting.addModule("/kernel/dpl/debug_log");
const mpu_armv7   = scripting.addModule("/kernel/dpl/mpu_armv7", {}, false);
const mpu_armv71  = mpu_armv7.addInstance();
const mpu_armv72  = mpu_armv7.addInstance();
const mpu_armv73  = mpu_armv7.addInstance();
const mpu_armv74  = mpu_armv7.addInstance();
const mpu_armv75  = mpu_armv7.addInstance();
const mpu_armv76  = mpu_armv7.addInstance();

/**
 * Write custom configuration values to the imported modules.
 */
bootloader1.bootMedia          = "EMMC";
bootloader1.$name              = "CONFIG_BOOTLOADER_R50_0";
bootloader1.EMMCAppImageOffset = "0x400000";

bootloader2.$name              = "CONFIG_BOOTLOADER_R50_1";
bootloader2.bootMedia          = "EMMC";
bootloader2.EMMCAppImageOffset = "0x800000";

bootloader3.$name              = "CONFIG_BOOTLOADER_R51_0";
bootloader3.bootMedia          = "EMMC";
bootloader3.EMMCAppImageOffset = "0xC00000";

bootloader4.$name              = "CONFIG_BOOTLOADER_R51_1";
bootloader4.bootMedia          = "EMMC";
bootloader4.EMMCAppImageOffset = "0x1000000";

bootloader5.$name              = "CONFIG_BOOTLOADER_C750";
bootloader5.bootMedia          = "EMMC";
bootloader5.EMMCAppImageOffset = "0x1400000";

bootloader6.$name              = "CONFIG_BOOTLOADER_C751";
bootloader6.bootMedia          = "EMMC";
bootloader6.EMMCAppImageOffset = "0x1800000";

bootloader1.MMCSDDriver = mmcsd1;
mmcsd1.$name            = "CONFIG_MMCSD_SBL";
bootloader2.MMCSDDriver = mmcsd1;
bootloader3.MMCSDDriver = mmcsd1;
bootloader4.MMCSDDriver = mmcsd1;
bootloader5.MMCSDDriver = mmcsd1;
bootloader6.MMCSDDriver = mmcsd1;

uart1.$name                      = "CONFIG_UART_APP";
uart1.useWakeupDomainPeripherals = true;
uart1.hwFlowControl              = true;

debug_log.enableUartLog             = true;
debug_log.uartLog.intrEnable        = "DISABLE";
debug_log.uartLog.$name             = "CONFIG_UART_SBL";
debug_log.uartLog.addedByBootloader = true;

mpu_armv71.size         = 31;
mpu_armv71.attributes   = "Device";
mpu_armv71.allowExecute = false;
mpu_armv71.$name        = "REGISTERS";

mpu_armv72.size       = 15;
mpu_armv72.$name      = "TCMA";
mpu_armv72.attributes = "NonCached";

mpu_armv73.baseAddr   = 0x41010000;
mpu_armv73.size       = 15;
mpu_armv73.$name      = "TCMB";
mpu_armv73.attributes = "NonCached";

mpu_armv74.$name    = "MSRAM_BANK0_TO_BANK3";
mpu_armv74.baseAddr = 0x72000000;
mpu_armv74.size     = 22;

mpu_armv75.$name    = "MSRAM_BANK4_TO_BANK5";
mpu_armv75.baseAddr = 0x72400000;
mpu_armv75.size     = 21;

mpu_armv76.$name             = "RESET_VECTORS";
mpu_armv76.size              = 7;
mpu_armv76.accessPermissions = "Supervisor RD+WR, User RD";

/**
 * Pinmux solution for unlocked pins/peripherals. This ensures that minor changes to the automatic solver in a future
 * version of the tool will not impact the pinmux you originally saw.  These lines can be completely deleted in order to
 * re-solve from scratch.
 */
mmcsd1.MMC.$suggestSolution                 = "MMC0";
mmcsd1.MMC.MMC_CLK.$suggestSolution         = "MMC0_CLK";
mmcsd1.MMC.MMC_CMD.$suggestSolution         = "MMC0_CMD";
mmcsd1.MMC.MMC_DAT0.$suggestSolution        = "MMC0_DAT0";
mmcsd1.MMC.MMC_DAT1.$suggestSolution        = "MMC0_DAT1";
mmcsd1.MMC.MMC_DAT2.$suggestSolution        = "MMC0_DAT2";
mmcsd1.MMC.MMC_DAT3.$suggestSolution        = "MMC0_DAT3";
mmcsd1.MMC.MMC_DAT4.$suggestSolution        = "MMC0_DAT4";
mmcsd1.MMC.MMC_DAT5.$suggestSolution        = "MMC0_DAT5";
mmcsd1.MMC.MMC_DAT6.$suggestSolution        = "MMC0_DAT6";
mmcsd1.MMC.MMC_DAT7.$suggestSolution        = "MMC0_DAT7";
uart1.WKUP_UART.$suggestSolution            = "WKUP_UART";
uart1.WKUP_UART.RXD.$suggestSolution        = "WKUP_UART0_RXD";
uart1.WKUP_UART.TXD.$suggestSolution        = "WKUP_UART0_TXD";
uart1.WKUP_UART.RTSn.$suggestSolution       = "WKUP_UART0_RTSn";
uart1.WKUP_UART.CTSn.$suggestSolution       = "WKUP_UART0_CTSn";
debug_log.uartLog.UART.$suggestSolution     = "UART0";
debug_log.uartLog.UART.RXD.$suggestSolution = "MCASP4_AXR0";
debug_log.uartLog.UART.TXD.$suggestSolution = "MLB0_MLBCLK";
