/**
 * @cliArgs --device "AM62x" --part "Default" --package "ALW" --context "r5fss0-0" --product "MCU_PLUS_SDK@07.03.01"
 * @versions {"tool":"1.23.0+4000"}
 */

/**
 * Import the modules used in this configuration.
 */
const bootloader  = scripting.addModule("/drivers/bootloader/bootloader", {}, false);
const bootloader1 = bootloader.addInstance();
const bootloader2 = bootloader.addInstance();
const bootloader3 = bootloader.addInstance();
const bootloader4 = bootloader.addInstance();
const gtc         = scripting.addModule("/drivers/gtc/gtc");
const mmcsd       = scripting.addModule("/drivers/mmcsd/mmcsd", {}, false);
const mmcsd1      = mmcsd.addInstance();
const clock       = scripting.addModule("/kernel/dpl/clock");
const debug_log   = scripting.addModule("/kernel/dpl/debug_log");

/**
 * Write custom configuration values to the imported modules.
 */
bootloader1.bootMedia          = "EMMC";
bootloader1.$name              = "CONFIG_BOOTLOADER_EMMC_HSM";
bootloader1.EMMCAppImageOffset = "0x800000";

bootloader2.bootMedia          = "EMMC";
bootloader2.$name              = "CONFIG_BOOTLOADER_EMMC_DM";
bootloader2.EMMCAppImageOffset = "0xA00000";

bootloader3.appImageOffset     = "0xC00000";
bootloader3.bootMedia          = "EMMC";
bootloader3.EMMCAppImageOffset = "0xC00000";
bootloader3.$name              = "CONFIG_BOOTLOADER_EMMC_A530_0";

bootloader4.appImageOffset     = "0x1400000";
bootloader4.bootMedia          = "EMMC";
bootloader4.$name              = "CONFIG_BOOTLOADER_EMMC_A530_1";
bootloader4.EMMCAppImageOffset = "0x1400000";

mmcsd1.$name            = "CONFIG_MMCSD0";
bootloader1.MMCSDDriver = mmcsd1;
bootloader2.MMCSDDriver = mmcsd1;
bootloader3.MMCSDDriver = mmcsd1;
bootloader4.MMCSDDriver = mmcsd1;
mmcsd1.MMC0.$assign     = "MMC0";

const udma             = scripting.addModule("/drivers/udma/udma", {}, false);
const udma1            = udma.addInstance({}, false);
udma1.$name            = "CONFIG_UDMA0";
bootloader1.udmaDriver = udma1;
bootloader2.udmaDriver = udma1;
bootloader3.udmaDriver = udma1;
bootloader4.udmaDriver = udma1;

const udma_blkcopy_channel     = scripting.addModule("/drivers/udma/udma_blkcopy_channel", {}, false);
const udma_blkcopy_channel1    = udma_blkcopy_channel.addInstance({}, false);
udma_blkcopy_channel1.$name    = "CONFIG_UDMA_BLKCOPY_CH0";
bootloader1.udmaBlkCopyChannel = udma_blkcopy_channel1;
bootloader2.udmaBlkCopyChannel = udma_blkcopy_channel1;
bootloader3.udmaBlkCopyChannel = udma_blkcopy_channel1;
bootloader4.udmaBlkCopyChannel = udma_blkcopy_channel1;

clock.instance = "TIMER1";

debug_log.enableUartLog                      = true;
debug_log.enableCssLog                       = false;
debug_log.uartLog.$name                      = "CONFIG_UART0";
debug_log.uartLog.useWakeupDomainPeripherals = false;
debug_log.uartLog.intrEnable                 = "DISABLE";

/**
 * Pinmux solution for unlocked pins/peripherals. This ensures that minor changes to the automatic solver in a future
 * version of the tool will not impact the pinmux you originally saw.  These lines can be completely deleted in order to
 * re-solve from scratch.
 */
mmcsd1.MMC0.CLK.$suggestSolution            = "MMC0_CLK";
mmcsd1.MMC0.CMD.$suggestSolution            = "MMC0_CMD";
mmcsd1.MMC0.DAT0.$suggestSolution           = "MMC0_DAT0";
mmcsd1.MMC0.DAT1.$suggestSolution           = "MMC0_DAT1";
mmcsd1.MMC0.DAT2.$suggestSolution           = "MMC0_DAT2";
mmcsd1.MMC0.DAT3.$suggestSolution           = "MMC0_DAT3";
mmcsd1.MMC0.DAT4.$suggestSolution           = "MMC0_DAT4";
mmcsd1.MMC0.DAT5.$suggestSolution           = "MMC0_DAT5";
mmcsd1.MMC0.DAT6.$suggestSolution           = "MMC0_DAT6";
mmcsd1.MMC0.DAT7.$suggestSolution           = "MMC0_DAT7";
debug_log.uartLog.UART.$suggestSolution     = "USART0";
debug_log.uartLog.UART.RXD.$suggestSolution = "UART0_RXD";
debug_log.uartLog.UART.TXD.$suggestSolution = "UART0_TXD";
