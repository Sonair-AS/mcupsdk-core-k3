/**
 * @cliArgs --device "AM275x" --part "AM2754" --package "ANJ" --context "wkup-r5fss0-0" --product "MCU_PLUS_SDK@07.03.01"
 * @versions {"tool":"1.21.0+3721"}
 */

/**
 * Import the modules used in this configuration.
 */
const bootloader  = scripting.addModule("/drivers/bootloader/bootloader", {}, false);
const bootloader1 = bootloader.addInstance();
const uart        = scripting.addModule("/drivers/uart/uart", {}, false);
const uart1       = uart.addInstance();
const debug_log   = scripting.addModule("/kernel/dpl/debug_log");
const mpu_armv7   = scripting.addModule("/kernel/dpl/mpu_armv7", {}, false);
const mpu_armv71  = mpu_armv7.addInstance();
const mpu_armv72  = mpu_armv7.addInstance();
const mpu_armv73  = mpu_armv7.addInstance();
const mpu_armv74  = mpu_armv7.addInstance();
const mpu_armv75  = mpu_armv7.addInstance();
const mpu_armv76  = mpu_armv7.addInstance();
const mpu_armv77  = mpu_armv7.addInstance();

/**
 * Write custom configuration values to the imported modules.
 */
bootloader1.$name     = "CONFIG_BOOTLOADER_APP";
bootloader1.bootMedia = "UART";

uart1.$name             = "CONFIG_UART_SBL";
uart1.intrEnable        = "DISABLE";
uart1.addedByBootloader = true;
uart1.UART.$assign      = "UART0";
uart1.UART.RXD.$assign  = "UART0_RXD";
uart1.UART.TXD.$assign  = "UART0_TXD";

debug_log.enableUartLog                      = true;
debug_log.uartTrace                          = true;
debug_log.uartLog.useWakeupDomainPeripherals = true;
debug_log.uartLog.intrEnable                 = "DISABLE";
debug_log.uartLog.$name                      = "CONFIG_UART_APP";

mpu_armv71.size         = 31;
mpu_armv71.attributes   = "Device";
mpu_armv71.allowExecute = false;
mpu_armv71.$name        = "CONFIG_MPU_REGISTER";

mpu_armv72.size       = 15;
mpu_armv72.attributes = "NonCached";
mpu_armv72.$name      = "CONFIG_MPU_TCMA";

mpu_armv73.baseAddr   = 0x41010000;
mpu_armv73.size       = 15;
mpu_armv73.attributes = "NonCached";
mpu_armv73.$name      = "CONFIG_MPU_TCMB";

mpu_armv74.baseAddr = 0x72000000;
mpu_armv74.$name    = "OSMC_RAM";
mpu_armv74.size     = 20;

mpu_armv75.$name    = "HSRAM";
mpu_armv75.size     = 19;
mpu_armv75.baseAddr = 0x43C00000;

mpu_armv76.$name        = "CONFIG_MPU_SOC_TCMA";
mpu_armv76.baseAddr     = 0x5C000000;
mpu_armv76.size         = 16;
mpu_armv76.attributes   = "NonCached";
mpu_armv76.allowExecute = false;

mpu_armv77.$name        = "UART0_REG";
mpu_armv77.baseAddr     = 0x28000000;
mpu_armv77.size         = 9;
mpu_armv77.attributes   = "Device";
mpu_armv77.allowExecute = false;

/**
 * Pinmux solution for unlocked pins/peripherals. This ensures that minor changes to the automatic solver in a future
 * version of the tool will not impact the pinmux you originally saw.  These lines can be completely deleted in order to
 * re-solve from scratch.
 */
debug_log.uartLog.WKUP_UART.$suggestSolution     = "WKUP_UART";
debug_log.uartLog.WKUP_UART.RXD.$suggestSolution = "WKUP_UART0_RXD";
debug_log.uartLog.WKUP_UART.TXD.$suggestSolution = "WKUP_UART0_TXD";
